## firmware/band-probe/main/Kconfig.projbuild
```kconfig
menu "Neural band"
    config BAND_OWNER_AUTH
        bool "Use an already enrolled owner identity"
        default n
        help
            Enable only when owner_identity.h contains the key currently enrolled
            on the band. With this disabled, use an unpaired band in pairing mode.
endmenu
```

## firmware/band-probe/sdkconfig.defaults
```kconfig
CONFIG_BT_ENABLED=y
CONFIG_BT_NIMBLE_ENABLED=y
CONFIG_BT_NIMBLE_ROLE_CENTRAL=y
CONFIG_BT_NIMBLE_ROLE_OBSERVER=y
CONFIG_BT_NIMBLE_L2CAP_COC_MAX_NUM=1
CONFIG_BT_NIMBLE_MAX_CONNECTIONS=1
CONFIG_ESP_CONSOLE_USB_SERIAL_JTAG=y
CONFIG_ESPTOOLPY_FLASHSIZE_16MB=y
CONFIG_BT_NIMBLE_NVS_PERSIST=y
CONFIG_BT_NIMBLE_HOST_TASK_STACK_SIZE=12288
CONFIG_MBEDTLS_HKDF_C=y

CONFIG_BAND_OWNER_AUTH=y
```
